



#include "vs1053.h"
#include "delay.h"
#include "mp3player.h"
#include "gui.h"
#include "pff.h"
#include "xpt2046.h"
#include "led.h"


extern u8 tbuf[512];


//音乐频谱分析补丁  必须加载此补丁才能正常显示音乐频谱
const u16 VS1053_PATCH[] = {
0x0007,0x0001,0x8d00,0x0006,0x0004,0x2803,0x5b40,0x0000,0x0024,0x0007,0x0001,0x8d02,
0x0006,0x00d6,0x3e12,0xb817,0x3e12,0x3815,0x3e05,0xb814,0x3615,0x0024,0x0000,0x800a,
0x3e10,0x3801,0x0006,0x0800,0x3e10,0xb803,0x0000,0x0303,0x3e11,0x3805,0x3e11,0xb807,
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0x0024,0x000a,0x0001,0x0d00,
};




u8 FFTbuf[15];    //频谱数组

// 新的频率值
const u16 VS_NEW_BANDS_FREQ_TBL[14]={80,300,800,1270,2016,3200,4500,6000,7500,9000,11000,13000,15000,20000};



//=====================================================================
// 名称：Mp3Player_Init()  
// 功能：播放器初始化
// 入口参数：无	 
// 出口参数：1:初始化成功, 0:初始化失败
// 说明：    
//=====================================================================
u8 Mp3Player_Init(void)
{
    u16 ret;
    VS_HD_Reset();          // 硬复位    	 
    ret = VS_Ram_Test();    // 存储器测试
    if(ret != 0X83FF && ret != 0x807F)return 0;
    VS_Set_Vol(120);        // 设置音量
    VS_Sine_Test();         // 正弦波测试
	VS_HD_Reset();          // 硬复位
	VS_Soft_Reset();        // 软复位
    return 1;
}



// 重设频谱频率
void SetBands(void)
{
  VS_Load_Patch((u16*)VS1053_PATCH,1000); 	  //加载频谱分析补丁
  VS_Set_Bands((u16*)VS_NEW_BANDS_FREQ_TBL,FFT_BANDS);//重设频谱频率
}



//显示一个音柱
//onex 音柱的x坐标值
//curval 当前值
//topval 峰值
void One_post(u8 onex,u8 curval,u8 topval)
{
 GUI_box(onex,fft_col_y,onex+fft_col_width,fft_col_y+fft_col_high,fft_bcolor);  //更新背景
 GUI_box(onex,fft_col_y+(fft_col_high-curval),onex+fft_col_width,fft_col_y+fft_col_high,fft_ycolor); //更新音柱
 GUI_box(onex,fft_col_y+(fft_col_high-topval),onex+fft_col_width,fft_col_y+(fft_col_high-topval),fft_fcolor);//更新峰值
}


struct TFT_Pointer sp_t;  //定义触摸变量结构体
_f_fftdev fftdev;	//定义fft变量管理结构体

//显示频谱功能函数
//*pbuf 采集的频谱数据
void FFT_post(u8 *pbuf)
{
 u8 i;
 u8 temp;

 for(i=0;i<FFT_BANDS;i++)	//显示各个频谱	   循环显示14个段
  {
   temp=pbuf[i]*2; 			//得到当前值,并乘2倍 主要为增加显示效果	因为输出的频率都相对较低

   if(fftdev.fft_cur[i]<temp) 	  //当前值小于temp
     fftdev.fft_cur[i]=temp;
   else							  //当前值大于等于temp	 开始往下降 一次降2
    {
	  if(fftdev.fft_cur[i]>1)fftdev.fft_cur[i]-=2;
	  else fftdev.fft_cur[i]=0;	
	}

   if(fftdev.fft_cur[i]>fftdev.fft_top[i])//当前值大于峰值时 更新峰值
    {
	  fftdev.fft_top[i]=fftdev.fft_cur[i];
	  fftdev.fft_time[i]=10;               //重设峰值停顿时间
	}

   if(fftdev.fft_time[i])fftdev.fft_time[i]--;   //如果停顿时间大于1 即未减完
   else 										   //停顿时间已减没
   {
   	if(fftdev.fft_top[i]) fftdev.fft_top[i]--;   //峰值下降1
   }


   if(fftdev.fft_cur[i]>63)fftdev.fft_cur[i]=63;	  //保证在范围内 因为前面有增倍效果
   if(fftdev.fft_top[i]>63)fftdev.fft_top[i]=63;

   One_post(fft_col_x+i*(fft_col_width+fft_col_away),fftdev.fft_cur[i],fftdev.fft_top[i]);
  
  }

}



//显示频谱主体函数
void Show_fft(void)
{
 VS_Get_Spec(FFTbuf); //提取频谱数据
 FFT_post(FFTbuf);	  //进行频谱效果显示
}



//初始化频谱管理数据
void init_fft(void)
{
  u8 i;
  for(i=0;i<FFT_BANDS;i++)	//初始化频谱管理数据
  {
   fftdev.fft_cur[i]=0;
   fftdev.fft_top[i]=60;
   fftdev.fft_time[i]=10;
  }
}


//MP3功能按键函数
//class  按键种类 目录1  上一首2  停止/开始3  下一首4
//status 按键状态 无按下1  按下2

void mp3_button(u8 class,u8 status)
{
 if(status==1)
  {
	switch(class)
	{
	case 1:
	GUI_box(0,270,59,319,Yellow);
	GUI_arcrectangle(17,280,24,6,2,Blue3,Blue3);
	GUI_arcrectangle(17,291,24,6,2,Blue3,Blue3);
	GUI_arcrectangle(17,302,24,6,2,Blue3,Blue3);
	break;
	
	case 2:
	GUI_box(60,270,119,319,Blue);
	GUI_triangle(102,280,30,Red,0);
	GUI_box(78,280,88,309,Red);
	break;
	
	case 3:
	GUI_box(120,270,179,319,Blue);
	GUI_box(151,280,161,309,Red);
	GUI_box(137,280,147,309,Red);
	break;
	
	case 4:
	GUI_box(180,270,239,319,Blue);
	GUI_triangle(197,280,30,Red,1);
	GUI_box(211,280,221,309,Red);
	break;
	}
  }
  else if(status==2)
  {
	switch(class)
	{
	case 1:
	GUI_box(0,270,59,319,Black);
	GUI_arcrectangle(17,280,24,6,2,White,White);
	GUI_arcrectangle(17,291,24,6,2,White,White);
	GUI_arcrectangle(17,302,24,6,2,White,White);
	break;
	
	case 2:
	GUI_box(60,270,119,319,White);
	GUI_triangle(102,280,30,Blue,0);
	GUI_box(78,280,88,309,Blue);
	break;
	
	case 3:
	GUI_box(120,270,179,319,White);
    GUI_triangle(144,280,30,Black,1);
	break;
	
	case 4:
	GUI_box(180,270,239,319,White);
	GUI_triangle(197,280,30,Blue,1);
	GUI_box(211,280,221,309,Blue);
	break;
	}
  }

}




//更新显示数据
//带入变量：
//fsize 文件的整体大小 单位：字节
//val   当前播放的字节数
//返回变量：
//返回进度值 进度值更新与否都要返回 为上一层函数计算做准备
u32 updata_play(u32 fsize,u32 val)
{
 u8 si=0; //当前进度比例值

 u16 now_time=0,  //当前时间
     total_time=0,//总时间
     kbps=0;	  //码率

 u8 min=0,		  //分
    sec=0;		  //秒

 u8 vol=0;		  //音量

 u32 course=0;	  //播放进程
 

 static u8 olds=0,		  //上一次的秒时间 防止总刷屏
		   osi=0,		  //上一次比例值
		   ttime=0;		  //总时间读取标志

 Show_fft();	  //频谱更新


 si=(val*228)/fsize;			//计算并更新整体进度条
 if(osi!=si)
 {
  GUI_box(6+osi,144,6+si,147,Blue1);
  osi=si;		
 }

//解码时间是真是解码多少 就是多少时间 如果进度跳转后 就不能代表当前播放的时间
//所以加进度可调功能后 屏蔽此功能 当前时间利用比特率计算
// now_time=VS_Get_DecodeTime();  //获得解码时间
//
// min=now_time/60;	//计算分
// sec=now_time%60;	//计算秒
//
// if(olds!=sec)
// {
//	number10(6,153,min,Yellow,Black);  //更新时间
//	number10(30,153,sec,Yellow,Black);
//
//	olds=sec;  //保存当前秒时间
// }


 kbps=VS_Get_HeadInfo();//得到码率

 //当前时间
 now_time=(val/kbps)/125;			   //根据比特率计算当前运行时间  1B=8b  1000b=125B

 min=now_time/60;	//计算分
 sec=now_time%60;	//计算秒

 if(olds!=sec)
 {
	number10(6,153,min,Yellow,Black);  //更新时间
	number10(30,153,sec,Yellow,Black);

	olds=sec;  //保存当前秒时间
 }

 //总时间
 if(ttime==0)							 //标志位控制 只显示一次
 {
	total_time=(fsize/kbps)/125;		 //根据比特率计算总时间  1B=8b  1000b=125B
	
    number10(54,153,total_time/60,Yellow,Black);  //显示总时间
	number10(78,153,total_time%60,Yellow,Black);

	number(177,153,kbps,Yellow,Black);				  //显示码率 kbps
	GUI_sprintf_hzstr16x(201,153,"kbps",Yellow,Black);

	ttime=1;    //总时间只更新一次 下一次不在进入
 }


// 		  mp3_button(2,2);
//		  delay_ms(5000);
//		  mp3_button(2,1);


 //触摸屏控制功能
 sp_t=TFT_Cm();	                          //扫描触摸屏
 ///*
 if(sp_t.flag==1)                           //是否有触摸事件 发生 
 {

	if(sp_t.y>180&&sp_t.y<195&&sp_t.x>40&&sp_t.x<187)		 //更新音量
	{
	  GUI_arcrectangle(40,185,146,6,2,Gray,Gray);
	  GUI_arcrectangle(40,185,sp_t.x-40,6,2,Cyan,Cyan);

	  //100-254  是比较可听的范围  所以从100开始 那么量程范围为154
	  vol=(154*(sp_t.x-40))/146;	 //计算预设音量

	  number10(40,194,(vol*48)/154,Gray,Black);	 //更新比例值

	  vol+=100;			 //加上前面隐藏掉的100

	  VS_Set_Vol(vol);	 //更新音量
	}

    if(sp_t.y>142&&sp_t.y<149&&sp_t.x>5&&sp_t.x<234)	//更改播放进度
	{
	  GUI_box(6,144,6+228,147,Black);			//更新进度显示

	  GUI_box(6,144,sp_t.x,147,Blue1);

	  osi=sp_t.x-5;								//更新上一次进度变量

	  course=(fsize*(sp_t.x-5))/228;				//根据触摸值计算 实际要指向的音乐字节位置	  
	
	  course-=course%512;						//尽可能是512的整数倍 方便偏移值指针计算

	  if(val!=course)return course;				//如果有进度更新 返回变化后进度值
	  else return val;
	}

    if(sp_t.y>270&&sp_t.y<320)
	 {
	   if(sp_t.x>0&&sp_t.x<60)
		{
		  mp3_button(1,2);
		  delay_ms(500);
		  mp3_button(1,1);
		   
		}

	   if(sp_t.x>60&&sp_t.x<120)
	    {
		  mp3_button(2,2);
		  delay_ms(500);
		  mp3_button(2,1);
		}

	   if(sp_t.x>120&&sp_t.x<180)
	    {
		  mp3_button(3,2);
		  delay_ms(500);
		  while(1)
		  {
		  	sp_t=TFT_Cm();
			if(sp_t.y>270&&sp_t.y<320&&sp_t.x>120&&sp_t.x<180)
			{
			 mp3_button(3,1);
			 break;
			}
		  }
		
		}

	   if(sp_t.x>180&&sp_t.x<240)
	 	{
		  mp3_button(4,2);
		  delay_ms(500);
		  mp3_button(4,1);

		
		}
	 
	 }

 }
//	*/
 return val;									//没有进度更新则返回带入时的进度值

}





extern FATFS fatfs;			//另声明文件系统主体调用结构体变量



void play_mp3(void)
{
  FRESULT res;
  u16 br;
  u32 cnt=0;
  u32 cnt2=0;
  u32 cnt3=0;
  u32 size=0;


  pf_open("/music/童话.mp3");	   //根目录下 打开文件夹music下的 童话歌曲

  size=fatfs.fsize;		//获取打开文件的总大小  单位：字节


  

  VS_Restart_Play();  					    // 重启播放 
  VS_Set_All();        					    // 设置音量等信息 			 
  VS_Reset_DecodeTime();					// 复位解码时间 
  VS_Set_Vol(Int_vol);                      // 设置音量初值
  VS_SPI_SpeedHigh();	                    // SPI设置为高速

  SetBands(); 								// 重设频谱频率

  init_fft();								//初始化频谱管理数据


   while(1)
   {
	res=pf_read(tbuf,512,&br);

    if((br!=512))                                 // 文件结束
    {
        break;
    }

	if((res!=FR_OK))
	{
	 // led(1); 
	  while(1);
	}
     cnt=0;


	 do{
	   	if(VS_Send_MusicData(tbuf+cnt)==0)
		{
		cnt+=32;
		cnt2+=32;	
		}
		else 
		{

        cnt3=updata_play(size,cnt2);

//		if(cnt3!=cnt2)
//		{
//		  cnt2=cnt3;
//		 // led(1);
//		  pf_lseek(cnt2);
//		//  led(0);
//		  break;
//		}
		
		}

	   }while(cnt<512);

   }


}







